#include "cheap03xD.dtsi" // The shared dtsi file is included in the overlay

// Label of the kscan node in the dtsi
&kscan0 {
    col-gpios
        = <&pro_micro 8 GPIO_ACTIVE_HIGH> //8 original cheap03xD pins
        , <&pro_micro 9 GPIO_ACTIVE_HIGH> //9
        , <&pro_micro 7 GPIO_ACTIVE_HIGH> //7
        , <&pro_micro 6 GPIO_ACTIVE_HIGH> //6
        , <&pro_micro 5 GPIO_ACTIVE_HIGH> //5
        ;
        
    row-gpios
        = <&pro_micro 14 (GPIO_ACTIVE_HIGH | GPIO_PULL_DOWN)> //14
        , <&pro_micro 16 (GPIO_ACTIVE_HIGH | GPIO_PULL_DOWN)> //16
        , <&pro_micro 10 (GPIO_ACTIVE_HIGH | GPIO_PULL_DOWN)> //10
        , <&pro_micro 15 (GPIO_ACTIVE_HIGH | GPIO_PULL_DOWN)> //15
        ;
};



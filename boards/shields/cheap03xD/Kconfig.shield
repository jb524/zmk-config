## boards/shields/cheap03xD/Kconfig.shield
```kconfig
# No whitespace after the comma or in your part name!
config SHIELD_CHEAP03XD_LEFT
    def_bool $(shields_list_contains,cheap03xD_left)
    select ZMK_BOARD_COMPAT

# No whitespace after the comma or in your part name!
config SHIELD_CHEAP03XD_RIGHT
    def_bool $(shields_list_contains,cheap03xD_right)
    select ZMK_BOARD_COMPAT
```

## boards/shields/chord03xD/Kconfig.defconfig
```kconfig
# Required files for ZMK to recognize the shield

if CHORD03XD

# Name must be less than 16 characters long!
config ZMK_KEYBOARD_NAME
    default "Chord03xD"

endif
```

## boards/shields/chord03xD/Kconfig.shield
```kconfig
# Required files for ZMK to recognize the shield

# No whitespace after the comma or in your keyboard name!
# Config name will be reused in Kconfig.defconfig
config CHORD03XD
    def_bool $(shields_list_contains,chord03xD)
```

## boards/shields/comb03xD/Kconfig.shield
```kconfig
# Required files for ZMK to recognize the shield

# No whitespace after the comma or in your keyboard name!
# Config name will be reused in Kconfig.defconfig
config COMB03XD
    def_bool $(shields_list_contains,comb03xD)
    select ZMK_BOARD_COMPAT
```

## boards/shields/crab03xD/Kconfig.shield
```kconfig
config SHIELD_CRAB03XD
    def_bool $(shields_list_contains,crab03xD
    select ZMK_BOARD_COMPAT)
```

## boards/shields/exp36/Kconfig.shield
```kconfig
# No whitespace after the comma or in your part name!
config SHIELD_EXP36_LEFT
    def_bool $(shields_list_contains,exp36_left)

# No whitespace after the comma or in your part name!
config SHIELD_EXP36_RIGHT
    def_bool $(shields_list_contains,exp36_right)
    
```

## boards/shields/fishKeeb/Kconfig.shield
```kconfig
config SHIELD_FISHKEEB
    def_bool $(shields_list_contains,fishKeeb)
    select ZMK_BOARD_COMPAT
```

## boards/shields/macr03xD/Kconfig.shield
```kconfig
config SHIELD_MACR03XD
    def_bool $(shields_list_contains,macr03xD)
    select ZMK_BOARD_COMPAT
```

## boards/shields/numer03xD/Kconfig.shield
```kconfig
config SHIELD_NUMER03XD
    def_bool $(shields_list_contains,numer03xD)
    select ZMK_BOARD_COMPAT
```

## boards/shields/splitFish/Kconfig.defconfig
```kconfig
if SHIELD_SPLITFISH_LEFT

# Name must be less than 16 characters long!
config ZMK_KEYBOARD_NAME
    default "splitFish"

#currently central is the left side
config ZMK_SPLIT_ROLE_CENTRAL
    default y

endif

if SHIELD_SPLITFISH_LEFT || SHIELD_SPLITFISH_RIGHT

config ZMK_SPLIT
    default y
    
endif
	
```

## boards/shields/splitFish/Kconfig.shield
```kconfig
# No whitespace after the comma or in your part name!
config SHIELD_SPLITFISH_LEFT
    def_bool $(shields_list_contains,splitFish_left)

# No whitespace after the comma or in your part name!
config SHIELD_SPLITFISH_RIGHT
    def_bool $(shields_list_contains,splitFish_right)
    
```

## boards/shields/sten02xD/Kconfig.defconfig
```kconfig
if SHIELD_STEN02XD_LEFT

config ZMK_KEYBOARD_NAME
    default "sten02xD"

#currently central is the left side
config ZMK_SPLIT_ROLE_CENTRAL
    default y

endif

if SHIELD_STEN02XD_LEFT || SHIELD_STEN02XD_RIGHT

config ZMK_SPLIT
    default y
    
#sleep settings
#Idle
config ZMK_IDLE_TIMEOUT
    default 20000

endif
	
```

## boards/shields/sten02xD/Kconfig.shield
```kconfig
# No whitespace after the comma or in your part name!
config SHIELD_STEN02XD_LEFT
    def_bool $(shields_list_contains,sten02xD_left)

# No whitespace after the comma or in your part name!
config SHIELD_STEN02XD_RIGHT
    def_bool $(shields_list_contains,sten02xD_right)
```

## boards/shields/sten03xD/Kconfig.defconfig
```kconfig
if SHIELD_STEN03XD_LEFT

config ZMK_KEYBOARD_NAME
    default "sten03xD"

#currently central is the left side
config ZMK_SPLIT_ROLE_CENTRAL
    default y

endif

if SHIELD_STEN03XD_LEFT || SHIELD_STEN03XD_RIGHT

config ZMK_SPLIT
    default y
    
#sleep settings
#Idle
config ZMK_IDLE_TIMEOUT
    default 20000

endif
	
```

## boards/shields/sten03xD/Kconfig.shield
```kconfig
# No whitespace after the comma or in your part name!
config SHIELD_STEN03XD_LEFT
    def_bool $(shields_list_contains,sten03xD_left)
    select ZMK_BOARD_COMPAT

# No whitespace after the comma or in your part name!
config SHIELD_STEN03XD_RIGHT
    def_bool $(shields_list_contains,sten03xD_right)
    select ZMK_BOARD_COMPAT
```

## config/dts/bindings/zmk,behavior-morse.yaml
```yaml
description: Custom Morse code behavior

compatible: "zmk,behavior-morse"

include: base.yaml

properties:
  label:
    type: string
    required: true

  "#binding-cells":
    type: int
    required: true
    const: 0
```

## config/src/dts/bindings/behaviors/zmk,behavior-morse.yaml
```yaml
compatible: "zmk,behavior-morse"

include: behavior.yaml

properties:
  label:
    type: string
    required: true
```

## config/west.yml
```yaml
manifest:
  defaults:
    revision: v0.3
  remotes:
    - name: zmkfirmware
      url-base: https://github.com/zmkfirmware
    - name: lander03xd
      url-base: https://github.com/lander03xd
    # Additional modules containing boards/shields/custom code can be listed here as well
    # See https://docs.zephyrproject.org/3.2.0/develop/west/manifest.html#projects
  projects:
    - name: zmk
      remote: zmkfirmware
      import: app/west.yml
    # Adding my own custom behavior
    - name: zmk-behavior-morse
      remote: lander03xd
      revision: main
      path: modules/zmk-module-lander03xd
  self:
    path: config
```
